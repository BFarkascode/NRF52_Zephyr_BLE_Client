## BLE_Client_GAP_test/boards/board.yml
```yaml
board:
  name: nrf52840_custom_board_v10
  full_name: nRF52840_custom_board_v10
  vendor: nordic
  socs:
  - name: nrf52840
```

## BLE_Client_GAP_test/boards/nrf52840_custom_board_v10_defconfig
```kconfig
# SPDX-License-Identifier: Apache-2.0

# Enable logger module
CONFIG_LOG=y

# Enable MPU
CONFIG_ARM_MPU=y

# Enable hardware stack protection
CONFIG_HW_STACK_PROTECTION=y

# Enable RTT
CONFIG_USE_SEGGER_RTT=y

# enable GPIO
CONFIG_GPIO=y

# enable uart driver
CONFIG_SERIAL=y

# enable console
CONFIG_CONSOLE=y
CONFIG_UART_CONSOLE=y

#enable i2c driver
CONFIG_I2C=y

# enable async uart driver
CONFIG_UART_ASYNC_API=y

# enable SPI
CONFIG_SPI=y

#BLE enable
CONFIG_BT=y

#BLE device name
CONFIG_BT_DEVICE_NAME="BLE_GAP_Client_test"

#BLE peripheral enable
CONFIG_BT_PERIPHERAL=y                                      

#BLE auto parameter update
CONFIG_BT_GAP_AUTO_UPDATE_CONN_PARAMS=y

# BLE PHY change enabled
CONFIG_BT_USER_PHY_UPDATE=y          

# BLE connection interval
CONFIG_BT_PERIPHERAL_PREF_MIN_INT=800
CONFIG_BT_PERIPHERAL_PREF_MAX_INT=800

# BLE connection latency
CONFIG_BT_PERIPHERAL_PREF_LATENCY=0

# BLE connection timeout
CONFIG_BT_PERIPHERAL_PREF_TIMEOUT=400

# BLE packet payload size change enabled
CONFIG_BT_USER_DATA_LEN_UPDATE=y
CONFIG_BT_CTLR_DATA_LENGTH_MAX=251
CONFIG_BT_BUF_ACL_RX_SIZE=251
CONFIG_BT_BUF_ACL_TX_SIZE=251

# GATT
CONFIG_BT_GATT_CLIENT=y
CONFIG_BT_L2CAP_TX_MTU=247

# BLE client
CONFIG_BT_CENTRAL=y
```

## BLE_Client_GATT_test/boards/board.yml
```yaml
board:
  name: nrf52840_custom_board_v11
  full_name: nRF52840_custom_board_v11
  vendor: nordic
  socs:
  - name: nrf52840
```
